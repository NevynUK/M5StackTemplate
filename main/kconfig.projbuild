## main/kconfig.projbuild
```kconfig
menu "Template Application Configuration"

    config ENABLE_DISPLAY
        bool "Enable display"
        default y
        help
            This option enables the display for visual output.

    config DISPLAY_WIDTH
        int "Display width"
        range 240 800
        default 720
        depends on ENABLE_DISPLAY
        help
            Width of the display in pixels.

    config DISPLAY_HEIGHT
        int "Display height"
        range 240 1280
        default 1280
        depends on ENABLE_DISPLAY
        help
            Height of the display in pixels.

    config ENABLE_TOUCH
        bool "Enable touch"
        default y
        depends on ENABLE_DISPLAY
        help
            Enables the touch screen for user input.
    
    config ENABLE_SD_CARD
        bool "Enable SD card"
        default y
        help
            This option enables the SD card for file storage and retrieval.

    config ENABLE_DIAGNOSTIC_THREAD
        bool "Enable diagnostic thread"
        default n
        help
            This option enables the diagnostic thread for monitoring system performance.

    config DIAGNOSTICS_INTERVAL_MS
        int "Diagnostics interval (ms)"
        range 10000 60000
        default 30000
        depends on ENABLE_DIAGNOSTIC_THREAD
        help
            Interval for collecting diagnostic data and sending this through the logging channel.

            Range 10,000 to 60,000 milliseconds (10 seconds to 60 seconds).
            Default is 30,000 milliseconds (30 seconds).

    config TRACE_RECORD_NUM
        int "Number of standalone trace records"
        range 10 500
        default 100
        depends on HEAP_TRACING_STANDALONE
        help
            Number of records that can be stored in the trace buffer.  This is used to store information
            about heap memory allocations and deallocations in order to attempt to detect memory leaks.

    config ENABLE_DETAILED_TASK_DIAGNOSTICS
        bool "Enable detailed task diagnostics"
        default n
        help
            This option enables detailed task diagnostics to monitor task performance and detect issues.
endmenu
```
